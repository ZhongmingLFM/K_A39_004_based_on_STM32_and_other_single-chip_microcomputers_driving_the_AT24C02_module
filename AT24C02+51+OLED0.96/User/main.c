/************************************************************************************
//（店名“众明工作室”）淘宝链接: https://shop149406681.taobao.com/?spm=a1z10.1-c.0.0.64cb457fKzgKea 
//淘宝店内搜索关键词：K_A39_004
//  版 本 号   : v1.0
//  作    者   : 众明工作室
//  交流群 :			 1041406448（其它更多资料请关注公告）
//    CSDN  （基本参数，资源更新列表，所有接线说明）   :单片机代码搬运工(搜索关键词：K_A39_004)
//    BILIBILI（演示视频） :众明工作室(搜索关键词：K_A39_004)
//  生成日期   : 2021-6-21
//  最近修改   : 2021-11-21
//  功能描述   : AT24C02模块测试程序
//  测试条件   : STC89C52RC   晶振11.0592
接线
AT24C02 -------------------------------STC89C52RC
VCC------------------------------------5V
GND------------------------------------GND
SCL------------------------------------P1.3 //
SDA------------------------------------P1.2 //	

OLED0.96(IIC) -------------------------STC89C52RC
VCC------------------------------------5V
GND------------------------------------GND
SCL------------------------------------P1^1
SDA------------------------------------P1^0
*************************************************************************************/
#include "AT24C0X.h"
#include "OLED.h"
#include "Uart.h"
#include "Delay.h"


uint8_t xdata DIS_Dat[10]={0};
/*******************************************************************************
* 函数名         :DigDisplay()
* 函数功能		 :OLED0.96显示函数
* 输入           : 无
* 输出         	 : 无
*******************************************************************************/
void DigDisplay()
{
	uint8_t j=0;
	OLED_P8x16Str(0, 0,"write:");

	for(j=0;j<8;j++)
	{
			DIS_Dat[j]=	Write_Dat[j];
	}
	DIS_Dat[8]=	'\0';
	OLED_P8x16Str(48, 0,DIS_Dat);
	UartSendStr("write:");	
	UartSendStr(DIS_Dat);	
	
	OLED_P8x16Str(0, 2,"Read:");
	for(j=0;j<8;j++)
	{
			DIS_Dat[j]=	Read_Dat[j];
	}
	DIS_Dat[8]=	'\0';
	OLED_P8x16Str(48, 2,DIS_Dat);
	UartSendStr("Read:");	
	UartSendStr(DIS_Dat);	
}




void main()//主函数模块// 
{ 

  	OLED_Init(); //OLED初始化
		UartInit();

		while(1) 
		{ 

		
				Write_data();
				 
				Read_data();
				
				DigDisplay();//oled0.96显示函数		

		} 
} 


